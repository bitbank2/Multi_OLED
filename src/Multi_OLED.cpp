//
// Multi OLED library
// Copyright (c) 2019 BitBank Software, Inc.
// Written by Larry Bank (bitbank@pobox.com)
// Project started 1/1/2019
//
// This program is free software: you can redistribute it and/or modify
// it under the terms of the GNU General Public License as published by
// the Free Software Foundation, either version 3 of the License, or
// (at your option) any later version.
//
// This program is distributed in the hope that it will be useful,
// but WITHOUT ANY WARRANTY; without even the implied warranty of
// MERCHANTABILITY or FITNESS FOR A PARTICULAR PURPOSE.  See the
// GNU General Public License for more details.
//
// You should have received a copy of the GNU General Public License
// along with this program.  If not, see <http://www.gnu.org/licenses/>.
//

#include <Arduino.h>
#ifdef __AVR__
#include <avr/pgmspace.h>
#endif
#include <Multi_BitBang.h>
#include <Multi_OLED.h>

//
// Comment out this line to gain 1K of RAM and not use a backing buffer
//
//#define USE_BACKBUFFER

// small (8x8) font
const byte ucFont[]PROGMEM = {0x00,0x00,0x00,0x00,0x00,0x00,0x00,0x00,0x7e,0x81,0x95,0xb1,0xb1,0x95,0x81,0x7e,
  0x7e,0xff,0xeb,0xcf,0xcf,0xeb,0xff,0x7e,0x0e,0x1f,0x3f,0x7e,0x3f,0x1f,0x0e,0x00,
  0x08,0x1c,0x3e,0x7f,0x3e,0x1c,0x08,0x00,0x38,0x9a,0x9f,0xff,0x9f,0x9a,0x38,0x00,
  0x10,0xb8,0xfc,0xfe,0xfc,0xb8,0x10,0x00,0x00,0x00,0x18,0x3c,0x3c,0x18,0x00,0x00,
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  0x02,0x03,0x01,0x03,0x02,0x03,0x01,0x00,0x70,0x78,0x4c,0x46,0x4c,0x78,0x70,0x00};

const byte ucBigFont[]PROGMEM = { 0x00,0x00,0x00,0x00,0x00,0x00,0x00,0x00,0x00,0x00,0x00,0x00,0x00,0x00,0x00,0x00,
  0x00,0x00,0x00,0x00,0x00,0x00,0x00,0x00,0x00,0x00,0x00,0x00,0x00,0x00,0x00,0x00,
  0x00,0x00,0x00,0x00,0x00,0x00,0x00,0x00,0x00,0x00,0x00,0x00,0x00,0x00,0x00,0x00,
  0x00,0x00,0x00,0x00,0x00,0x00,0x00,0x00,0x00,0x00,0x00,0x00,0x00,0x00,0x00,0x00,
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  0x00,0x00,0x00,0x00,0x00,0x00,0x00,0x00,0x00,0x00,0x00,0x00,0x00,0x00,0x00,0x00};

  // 5x7 font (in 6x8 cell)
const byte ucSmallFont[]PROGMEM = {0x00,0x00,0x00,0x00,0x00,0x00,0x00,0x3e,0x45,0x51,0x45,0x3e,0x00,0x3e,0x6b,0x6f,
  0x6b,0x3e,0x00,0x1c,0x3e,0x7c,0x3e,0x1c,0x00,0x18,0x3c,0x7e,0x3c,0x18,0x00,0x30,
  0x36,0x7f,0x36,0x30,0x00,0x18,0x5c,0x7e,0x5c,0x18,0x00,0x00,0x18,0x18,0x00,0x00,
  0x00,0xff,0xe7,0xe7,0xff,0xff,0x00,0x3c,0x24,0x24,0x3c,0x00,0x00,0xc3,0xdb,0xdb,
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  0x41,0x41,0x3e,0x08,0x00,0x02,0x01,0x02,0x01,0x00,0x00,0x3c,0x26,0x23,0x26,0x3c};

// Since AVRs have so little RAM, we'll set the max displays to 8
#ifdef __AVR__
#define MAX_DISPLAYS 8
#else
#define MAX_DISPLAYS 16
#endif

// some globals
static int iScreenOffset; // current write offset of screen data
#ifdef USE_BACKBUFFER
static unsigned char ucScreen[1024]; // local copy of the image buffer
#endif
static uint8_t oled_flips[MAX_DISPLAYS], oled_addrs[MAX_DISPLAYS], oled_types[MAX_DISPLAYS], oled_buses[MAX_DISPLAYS];
static uint8_t iCurrentBus, iDisplayCount, oled_flip, oled_addr, oled_type;
static void Multi_OLEDWriteCommand(uint8_t c);
//
// Set the internal variables for the current display
//
static inline uint8_t SetDisplay(uint8_t iDisplay)
{
  if (iDisplay >= iDisplayCount)
     return 0;

  iCurrentBus = oled_buses[iDisplay];
  oled_flip = oled_flips[iDisplay];
  oled_type = oled_types[iDisplay];
  oled_addr = oled_addrs[iDisplay];

  return 1;
} /* SetDisplay() */

//
// Initializes the OLED controller into "page mode"
//
void Multi_OLEDInit(uint8_t *iBus, uint8_t *iAddr, uint8_t *iType, uint8_t *bFlip, uint8_t *bInvert, uint8_t iCount)
{
unsigned char uc[4];
const unsigned char oled64_initbuf[]={0x00,0xae,0xa8,0x3f,0xd3,0x00,0x40,0xa1,0xc8,
      0xda,0x12,0x81,0xff,0xa4,0xa6,0xd5,0x80,0x8d,0x14,
      0xaf,0x20,0x02};
const unsigned char oled32_initbuf[] = {
0x00,0xae,0xd5,0x80,0xa8,0x1f,0xd3,0x00,0x40,0x8d,0x14,0xa1,0xc8,0xda,0x02,
0x81,0x7f,0xd9,0xf1,0xdb,0x40,0xa4,0xa6,0xaf};
uint8_t iDisplay;

  if (iCount > MAX_DISPLAYS)
     return;
  iDisplayCount = iCount;
  memcpy(oled_addrs, iAddr, iCount);
  memcpy(oled_flips, bFlip, iCount);
  memcpy(oled_types, iType, iCount);
  memcpy(oled_buses, iBus, iCount);

  for (iDisplay=0; iDisplay<iCount; iDisplay++)
  {
    SetDisplay(iDisplay);
    if (oled_type == OLED_128x32)
      Multi_I2CWrite(iCurrentBus, oled_addr, (unsigned char *)oled32_initbuf, sizeof(oled32_initbuf));
    else // 132x64, 128x64 and 64x32
      Multi_I2CWrite(iCurrentBus, oled_addr, (unsigned char *)oled64_initbuf, sizeof(oled64_initbuf));
    if (bInvert[iDisplay])
    {
      uc[0] = 0; // command
      uc[1] = 0xa7; // invert command
      Multi_I2CWrite(iCurrentBus, oled_addr, uc, 2);
    }
    if (bFlip[iDisplay]) // rotate display 180
    {
      uc[0] = 0; // command
      uc[1] = 0xa0;
      Multi_I2CWrite(iCurrentBus, oled_addr, uc, 2);
      uc[1] = 0xc0;
      Multi_I2CWrite(iCurrentBus, oled_addr, uc, 2);
    }
  } // for each I2C display
} /* Multi_OLEDInit() */
//
// Sends a command to turn on or off the OLED display
//
void Multi_OLEDPower(uint8_t iDisplay, uint8_t bOn)
{
    if (!SetDisplay(iDisplay))
       return;
    if (bOn)
      Multi_OLEDWriteCommand(0xaf); // turn on OLED
    else
      Multi_OLEDWriteCommand(0xae); // turn off OLED
} /* Multi_OLEDPower() */

// Send a single byte command to the OLED controller
static void Multi_OLEDWriteCommand(uint8_t c)
{
uint8_t buf[2];

  buf[0] = 0x00; // command introducer
  buf[1] = c;
  Multi_I2CWrite(iCurrentBus, oled_addr, buf, 2);
} /* oledWriteCommand() */

static void Multi_OLEDWriteCommand2(unsigned char c, unsigned char d)
{
unsigned char buf[3];

  buf[0] = 0x00;
  buf[1] = c;
  buf[2] = d;
  Multi_I2CWrite(iCurrentBus, oled_addr, buf, 3);
} /* oledWriteCommand2() */

//
// Sets the brightness (0=off, 255=brightest)
//
void Multi_OLEDSetContrast(uint8_t iDisplay, uint8_t ucContrast)
{
  if (!SetDisplay(iDisplay))
     return;
  Multi_OLEDWriteCommand2(0x81, ucContrast);
} /* Multi_OLEDSetContrast() */

//
// Send commands to position the "cursor" (aka memory write address)
// to the given row and column
//
static void Multi_OLEDSetPosition(int x, int y)
{
  if (oled_type == OLED_64x32) // visible display starts at column 32, row 4
  {
    x += 32; // display is centered in VRAM, so this is always true
    if (oled_flip == 0) // non-flipped display starts from line 4
       y += 4;
  }
  if (oled_type == OLED_132x64) // 128 centered on 132
  {
    x += 2;
  }
  Multi_OLEDWriteCommand(0xb0 | y); // go to page Y
  Multi_OLEDWriteCommand(0x00 | (x & 0xf)); // // lower col addr
  Multi_OLEDWriteCommand(0x10 | ((x >> 4) & 0xf)); // upper col addr
  iScreenOffset = (y*128)+x;
} /* Multi_OLEDSetPosition() */

//
// Write a block of pixel data to the OLED
// Length can be anything from 1 to 1024 (whole display)
//
static void Multi_OLEDWriteDataBlock(unsigned char *ucBuf, int iLen)
{
unsigned char ucTemp[129];

  ucTemp[0] = 0x40; // data command
  memcpy(&ucTemp[1], ucBuf, iLen);
  Multi_I2CWrite(iCurrentBus, oled_addr, ucTemp, iLen+1);
  // Keep a copy in local buffer
#ifdef USE_BACKBUFFER
  memcpy(&ucScreen[iScreenOffset], ucBuf, iLen);
  iScreenOffset += iLen;
#endif
} /* Multi_OLEDWriteDataBlock() */

// Set (or clear) an individual pixel
// The local copy of the frame buffer is used to avoid
// reading data from the display controller
int Multi_OLEDSetPixel(uint8_t iDisplay, int x, int y, unsigned char ucColor)
{
int i;
unsigned char uc, ucOld;

  if (!SetDisplay(iDisplay))
     return -1;
  i = ((y >> 3) * 128) + x;
  if (i < 0 || i > 1023) // off the screen
    return -1;
#ifdef USE_BACKBUFFER
  uc = ucOld = ucScreen[i];
#else
  uc = ucOld = 0;
#endif

  uc &= ~(0x1 << (y & 7));
  if (ucColor)
  {
    uc |= (0x1 << (y & 7));
  }
  if (uc != ucOld) // pixel changed
  {
    Multi_OLEDSetPosition(x, y>>3);
    Multi_OLEDWriteDataBlock(&uc, 1);
#ifdef USE_BACKBUFFER
    ucScreen[i] = uc;
#endif
  }
  return 0;
} /* Multi_OLEDSetPixel() */

//
// Invert font data
//
static void InvertBytes(byte *pData, byte bLen)
{
byte i;
   for (i=0; i<bLen; i++)
   {
      *pData = ~(*pData);
      pData++;
   }
} /* InvertBytes() */

//
// Load a 128x64 1-bpp Windows bitmap
// Pass the pointer to the beginning of the BMP file
// First pass version assumes a full screen bitmap
//
int Multi_OLEDLoadBMP(uint8_t iDisplay, uint8_t *pBMP)
{
int16_t i16;
int iOffBits, q, y, j; // offset to bitmap data
int iPitch;
byte x, z, b, *s;
byte dst_mask;
byte ucTemp[16]; // process 16 bytes at a time
byte bFlipped = false;

  if (!SetDisplay(iDisplay))
     return -1;
  i16 = pgm_read_word(pBMP);
  if (i16 != 0x4d42) // must start with 'BM'
     return -1; // not a BMP file
  i16 = pgm_read_word(pBMP + 18);
  if (i16 != 128) // must be 128 pixels wide
     return -1;
  i16 = pgm_read_word(pBMP + 22);
  if (i16 != 64 && i16 != -64) // must be 64 pixels tall
     return -1;
  if (i16 == 64) // BMP is flipped vertically (typical)
     bFlipped = true;
  i16 = pgm_read_word(pBMP + 28);
  if (i16 != 1) // must be 1 bit per pixel
     return -1;
  iOffBits = pgm_read_word(pBMP + 10);
  iPitch = 16;
  if (bFlipped)
  { 
    iPitch = -16;
    iOffBits += (63 * 16); // start from bottom
  }

// rotate the data and send it to the display
  for (y=0; y<8; y++) // 8 lines of 8 pixels
  {
     Multi_OLEDSetPosition(0, y);
     for (j=0; j<8; j++) // do 8 sections of 16 columns
     {
         s = &pBMP[iOffBits + (j*2) + (y * iPitch*8)]; // source line
         memset(ucTemp, 0, 16); // start with all black
         for (x=0; x<16; x+=8) // do each block of 16x8 pixels
         {
            dst_mask = 1;
            for (q=0; q<8; q++) // gather 8 rows
            {
               b = pgm_read_byte(s + (q * iPitch));
               for (z=0; z<8; z++) // gather up the 8 bits of this column
               {
                  if (b & 0x80)
                      ucTemp[x+z] |= dst_mask;
                  b <<= 1;
               } // for z
               dst_mask <<= 1;
            } // for q
            s++; // next source byte
         } // for x
         Multi_OLEDWriteDataBlock(ucTemp, 16);
     } // for j
  } // for y
  return 0;
} /* Multi_OLEDLoadBMP() */

//
// Draw a string of normal (8x8), small (6x8) or large (16x32) characters
// At the given col+row
//
int Multi_OLEDWriteString(uint8_t iDisplay, int x, int y, char *szMsg, int iSize, int bInvert)
{
int i, iLen, iFontOff;
unsigned char c, *s, ucTemp[16];

    if (!SetDisplay(iDisplay))
       return -1;
    iLen = strlen(szMsg);
    Multi_OLEDSetPosition(x, y);
    if (iSize == FONT_NORMAL) // 8x8 font
    {
       if (iLen*8 + x > 128) iLen = (128 - x)/8; // can't display it
       if (iLen < 0)return -1;

       for (i=0; i<iLen; i++)
       {
         c = (unsigned char)szMsg[i];
         iFontOff =  (int)c * 8;
         // we can't directly use the pointer to FLASH memory, so copy to a local buffer
         memcpy_P(ucTemp, &ucFont[iFontOff], 8);
         if (bInvert) InvertBytes(ucTemp, 8);
         Multi_OLEDWriteDataBlock(ucTemp, 8); // write character pattern
       }
    }
    else if (iSize == FONT_LARGE) // 16x32 font
    {
      if (iLen*16+x > 128) iLen = (128-x)/16;
      if (iLen < 0) return -1;
      for (i=0; i<iLen; i++)
      {
          s = (unsigned char *)&ucBigFont[(unsigned char)szMsg[i]*64];
          // we can't directly use the pointer to FLASH memory, so copy to a local buffer
          Multi_OLEDSetPosition(x+(i*16), y);
          memcpy_P(ucTemp, s, 16);
          if (bInvert) InvertBytes(ucTemp, 16);
          Multi_OLEDWriteDataBlock(ucTemp, 16); // write character pattern
          Multi_OLEDSetPosition(x+(i*16), y+1);
          memcpy_P(ucTemp, s+16, 16);
          if (bInvert) InvertBytes(ucTemp, 16);
          Multi_OLEDWriteDataBlock(ucTemp, 16); // write character pattern
          if (y <= 5)
          {
             Multi_OLEDSetPosition(x+(i*16), y+2);
             memcpy_P(ucTemp, s+32, 16);
             if (bInvert) InvertBytes(ucTemp, 16);
             Multi_OLEDWriteDataBlock(ucTemp, 16); // write character pattern
          }
          if (y <= 4)
          {
             Multi_OLEDSetPosition(x+(i*16), y+3);
             memcpy_P(ucTemp, s+48, 16);
             if (bInvert) InvertBytes(ucTemp, 16);
             Multi_OLEDWriteDataBlock(ucTemp, 16); // write character pattern
          }
       }
    }
    else if (iSize == FONT_SMALL) // 6x8 font
    {
       if (iLen*6 + x > 128) iLen = (128 - x)/6; // can't display it
       if (iLen < 0)return -1;

       for (i=0; i<iLen; i++)
       {
         // we can't directly use the pointer to FLASH memory, so copy to a local buffer
         memcpy_P(ucTemp, &ucSmallFont[(unsigned char)szMsg[i]*6], 6);
         if (bInvert) InvertBytes(ucTemp, 6);
         Multi_OLEDWriteDataBlock(ucTemp, 6); // write character pattern
       }
    }
  return 0;
} /* Multi_OLEDWriteString() */

//
// Fill the frame buffer with a byte pattern
// e.g. all off (0x00) or all on (0xff)
//
void Multi_OLEDFill(uint8_t iDisplay, uint8_t ucData)
{
int x, y;
int iLines, iCols;
unsigned char temp[16];

  if (!SetDisplay(iDisplay))
     return;
  iLines = (oled_type == OLED_128x32 || oled_type == OLED_64x32) ? 4:8;
  iCols = (oled_type == OLED_64x32) ? 4:8;
  memset(temp, ucData, 16);
  for (y=0; y<iLines; y++)
  {
    Multi_OLEDSetPosition(0,y); // set to (0,Y)
    for (x=0; x<iCols; x++) // wiring library has a 32-byte buffer, so send 16 bytes so that the data prefix (0x40) can fit
    {
      Multi_OLEDWriteDataBlock(temp, 16); 
    } // for x
  } // for y
#ifdef USE_BACKBUFFER
   memset(ucScreen, ucData, 1024);
#endif
} /* oledFill() */

